/**
 * These arguments were used when this file was generated. They will be automatically applied on subsequent loads
 * via the GUI or CLI. Run CLI with '--help' for additional information on how to override these arguments.
 * @cliArgs --board "/ti/boards/LP_MSPM0G3507" --product "mspm0_sdk@2.09.00.00"
 * @v2CliArgs --board "/ti/boards/LP_MSPM0G3507" --product "mspm0_sdk@2.09.00.00"
 * @versions {"tool":"1.27.1+4634"}
 */

/**
 * Import the modules used in this configuration.
 */
const GPIO   = scripting.addModule("/ti/driverlib/GPIO", {}, false);
const GPIO1  = GPIO.addInstance();
const GPIO2  = GPIO.addInstance();
const GPIO3  = GPIO.addInstance();
const GPIO4  = GPIO.addInstance();
const GPIO5  = GPIO.addInstance();
const GPIO6  = GPIO.addInstance();
const PWM    = scripting.addModule("/ti/driverlib/PWM", {}, false);
const PWM1   = PWM.addInstance();
const PWM2   = PWM.addInstance();
const SYSCTL = scripting.addModule("/ti/driverlib/SYSCTL");
const UART   = scripting.addModule("/ti/driverlib/UART", {}, false);
const UART1  = UART.addInstance();

/**
 * Write custom configuration values to the imported modules.
 */
GPIO1.port                               = "PORTB";
GPIO1.$name                              = "KEY";
GPIO1.associatedPins.create(4);
GPIO1.associatedPins[0].direction        = "INPUT";
GPIO1.associatedPins[0].assignedPin      = "21";
GPIO1.associatedPins[0].polarity         = "RISE";
GPIO1.associatedPins[0].$name            = "k4";
GPIO1.associatedPins[0].internalResistor = "PULL_UP";
GPIO1.associatedPins[1].$name            = "k1";
GPIO1.associatedPins[1].direction        = "INPUT";
GPIO1.associatedPins[1].assignedPin      = "14";
GPIO1.associatedPins[1].internalResistor = "PULL_UP";
GPIO1.associatedPins[2].$name            = "k2";
GPIO1.associatedPins[2].direction        = "INPUT";
GPIO1.associatedPins[2].assignedPin      = "19";
GPIO1.associatedPins[2].internalResistor = "PULL_UP";
GPIO1.associatedPins[3].$name            = "k3";
GPIO1.associatedPins[3].direction        = "INPUT";
GPIO1.associatedPins[3].assignedPin      = "20";
GPIO1.associatedPins[3].internalResistor = "PULL_UP";

const Board = scripting.addModule("/ti/driverlib/Board", {}, false);

GPIO2.$name                              = "Line";
GPIO2.associatedPins.create(8);
GPIO2.associatedPins[0].direction        = "INPUT";
GPIO2.associatedPins[0].assignedPin      = "7";
GPIO2.associatedPins[0].internalResistor = "PULL_UP";
GPIO2.associatedPins[0].$name            = "OUT1";
GPIO2.associatedPins[1].$name            = "OUT2";
GPIO2.associatedPins[1].direction        = "INPUT";
GPIO2.associatedPins[1].internalResistor = "PULL_UP";
GPIO2.associatedPins[1].assignedPin      = "12";
GPIO2.associatedPins[1].assignedPort     = "PORTB";
GPIO2.associatedPins[2].$name            = "OUT3";
GPIO2.associatedPins[2].direction        = "INPUT";
GPIO2.associatedPins[2].assignedPort     = "PORTB";
GPIO2.associatedPins[2].assignedPin      = "5";
GPIO2.associatedPins[2].internalResistor = "PULL_UP";
GPIO2.associatedPins[3].$name            = "OUT4";
GPIO2.associatedPins[3].direction        = "INPUT";
GPIO2.associatedPins[3].assignedPort     = "PORTB";
GPIO2.associatedPins[3].assignedPin      = "4";
GPIO2.associatedPins[3].internalResistor = "PULL_UP";
GPIO2.associatedPins[4].$name            = "OUT5";
GPIO2.associatedPins[4].internalResistor = "PULL_UP";
GPIO2.associatedPins[4].assignedPort     = "PORTA";
GPIO2.associatedPins[4].assignedPin      = "31";
GPIO2.associatedPins[4].direction        = "INPUT";
GPIO2.associatedPins[5].$name            = "OUT6";
GPIO2.associatedPins[5].direction        = "INPUT";
GPIO2.associatedPins[5].assignedPort     = "PORTA";
GPIO2.associatedPins[5].assignedPin      = "28";
GPIO2.associatedPins[5].internalResistor = "PULL_UP";
GPIO2.associatedPins[6].$name            = "OUT7";
GPIO2.associatedPins[6].direction        = "INPUT";
GPIO2.associatedPins[6].assignedPort     = "PORTA";
GPIO2.associatedPins[6].assignedPin      = "8";
GPIO2.associatedPins[7].$name            = "OUT8";
GPIO2.associatedPins[7].assignedPort     = "PORTA";
GPIO2.associatedPins[7].assignedPin      = "9";
GPIO2.associatedPins[7].internalResistor = "PULL_UP";
GPIO2.associatedPins[7].direction        = "INPUT";

GPIO3.$name                          = "LED";
GPIO3.associatedPins[0].$name        = "LED0";
GPIO3.associatedPins[0].assignedPort = "PORTB";
GPIO3.associatedPins[0].assignedPin  = "22";

GPIO4.$name                          = "tb6612";
GPIO4.associatedPins.create(8);
GPIO4.associatedPins[0].$name        = "AIN1_F";
GPIO4.associatedPins[0].assignedPin  = "14";
GPIO4.associatedPins[0].assignedPort = "PORTA";
GPIO4.associatedPins[1].$name        = "BIN1_F";
GPIO4.associatedPins[1].assignedPort = "PORTA";
GPIO4.associatedPins[1].assignedPin  = "12";
GPIO4.associatedPins[2].$name        = "BIN2_F";
GPIO4.associatedPins[2].assignedPort = "PORTA";
GPIO4.associatedPins[2].assignedPin  = "13";
GPIO4.associatedPins[3].$name        = "AIN1_B";
GPIO4.associatedPins[3].assignedPort = "PORTB";
GPIO4.associatedPins[3].assignedPin  = "8";
GPIO4.associatedPins[4].$name        = "AIN2_B";
GPIO4.associatedPins[4].assignedPort = "PORTB";
GPIO4.associatedPins[4].assignedPin  = "9";
GPIO4.associatedPins[5].$name        = "BIN1_B";
GPIO4.associatedPins[5].assignedPort = "PORTB";
GPIO4.associatedPins[5].assignedPin  = "23";
GPIO4.associatedPins[6].$name        = "BIN2_B";
GPIO4.associatedPins[6].assignedPort = "PORTB";
GPIO4.associatedPins[6].assignedPin  = "26";
GPIO4.associatedPins[7].$name        = "AIN2_F";
GPIO4.associatedPins[7].assignedPort = "PORTA";
GPIO4.associatedPins[7].assignedPin  = "15";

GPIO5.$name                              = "SPI";
GPIO5.associatedPins.create(5);
GPIO5.associatedPins[0].$name            = "CE";
GPIO5.associatedPins[0].assignedPort     = "PORTA";
GPIO5.associatedPins[0].assignedPin      = "22";
GPIO5.associatedPins[1].$name            = "CSN";
GPIO5.associatedPins[1].assignedPort     = "PORTA";
GPIO5.associatedPins[1].assignedPin      = "24";
GPIO5.associatedPins[2].$name            = "SCK";
GPIO5.associatedPins[2].assignedPort     = "PORTA";
GPIO5.associatedPins[2].assignedPin      = "25";
GPIO5.associatedPins[2].initialValue     = "SET";
GPIO5.associatedPins[2].pin.$assign      = "boosterpack.2";
GPIO5.associatedPins[3].$name            = "MOSI";
GPIO5.associatedPins[3].assignedPort     = "PORTA";
GPIO5.associatedPins[3].assignedPin      = "27";
GPIO5.associatedPins[4].$name            = "MISO";
GPIO5.associatedPins[4].assignedPort     = "PORTA";
GPIO5.associatedPins[4].direction        = "INPUT";
GPIO5.associatedPins[4].internalResistor = "PULL_UP";
GPIO5.associatedPins[4].assignedPin      = "30";

GPIO6.$name                              = "encoder_jie";
GPIO6.associatedPins.create(8);
GPIO6.associatedPins[0].$name            = "FLA";
GPIO6.associatedPins[0].assignedPort     = "PORTB";
GPIO6.associatedPins[0].assignedPin      = "0";
GPIO6.associatedPins[0].direction        = "INPUT";
GPIO6.associatedPins[0].internalResistor = "PULL_UP";
GPIO6.associatedPins[0].interruptEn      = true;
GPIO6.associatedPins[0].polarity         = "FALL";
GPIO6.associatedPins[1].$name            = "FLB";
GPIO6.associatedPins[1].direction        = "INPUT";
GPIO6.associatedPins[1].assignedPort     = "PORTB";
GPIO6.associatedPins[1].assignedPin      = "1";
GPIO6.associatedPins[1].interruptEn      = true;
GPIO6.associatedPins[1].polarity         = "FALL";
GPIO6.associatedPins[2].$name            = "FRA";
GPIO6.associatedPins[2].direction        = "INPUT";
GPIO6.associatedPins[2].assignedPort     = "PORTB";
GPIO6.associatedPins[2].assignedPin      = "10";
GPIO6.associatedPins[2].interruptEn      = true;
GPIO6.associatedPins[2].polarity         = "FALL";
GPIO6.associatedPins[3].$name            = "FRB";
GPIO6.associatedPins[3].direction        = "INPUT";
GPIO6.associatedPins[3].assignedPort     = "PORTB";
GPIO6.associatedPins[3].assignedPin      = "11";
GPIO6.associatedPins[3].interruptEn      = true;
GPIO6.associatedPins[3].polarity         = "FALL";
GPIO6.associatedPins[4].$name            = "BLA";
GPIO6.associatedPins[4].direction        = "INPUT";
GPIO6.associatedPins[4].assignedPort     = "PORTB";
GPIO6.associatedPins[4].assignedPin      = "13";
GPIO6.associatedPins[4].interruptEn      = true;
GPIO6.associatedPins[4].polarity         = "FALL";
GPIO6.associatedPins[5].$name            = "BLB";
GPIO6.associatedPins[5].direction        = "INPUT";
GPIO6.associatedPins[5].assignedPort     = "PORTB";
GPIO6.associatedPins[5].assignedPin      = "16";
GPIO6.associatedPins[5].interruptEn      = true;
GPIO6.associatedPins[5].polarity         = "FALL";
GPIO6.associatedPins[6].$name            = "BRA";
GPIO6.associatedPins[6].direction        = "INPUT";
GPIO6.associatedPins[6].assignedPort     = "PORTB";
GPIO6.associatedPins[6].assignedPin      = "24";
GPIO6.associatedPins[6].interruptEn      = true;
GPIO6.associatedPins[6].polarity         = "FALL";
GPIO6.associatedPins[7].$name            = "BRB";
GPIO6.associatedPins[7].direction        = "INPUT";
GPIO6.associatedPins[7].assignedPin      = "27";
GPIO6.associatedPins[7].assignedPort     = "PORTB";
GPIO6.associatedPins[7].interruptEn      = true;
GPIO6.associatedPins[7].polarity         = "FALL";

PWM1.$name                      = "PWM_0";
PWM1.timerCount                 = 3200;
PWM1.peripheral.$assign         = "TIMA1";
PWM1.peripheral.ccp0Pin.$assign = "boosterpack.28";
PWM1.peripheral.ccp1Pin.$assign = "boosterpack.29";
PWM1.PWM_CHANNEL_0.$name        = "ti_driverlib_pwm_PWMTimerCC0";
PWM1.PWM_CHANNEL_1.$name        = "ti_driverlib_pwm_PWMTimerCC1";
PWM1.ccp0PinConfig.$name        = "ti_driverlib_gpio_GPIOPinGeneric2";
PWM1.ccp1PinConfig.$name        = "ti_driverlib_gpio_GPIOPinGeneric3";

PWM2.$name                      = "PWM_1";
PWM2.timerCount                 = 3200;
PWM2.peripheral.$assign         = "TIMG6";
PWM2.peripheral.ccp0Pin.$assign = "boosterpack.13";
PWM2.peripheral.ccp1Pin.$assign = "boosterpack.14";
PWM2.PWM_CHANNEL_0.$name        = "ti_driverlib_pwm_PWMTimerCC0_1";
PWM2.PWM_CHANNEL_1.$name        = "ti_driverlib_pwm_PWMTimerCC1_1";
PWM2.ccp0PinConfig.$name        = "ti_driverlib_gpio_GPIOPinGeneric4";
PWM2.ccp1PinConfig.$name        = "ti_driverlib_gpio_GPIOPinGeneric5";

SYSCTL.MFPCLKEn = true;

UART1.$name                    = "UART_0";
UART1.enabledInterrupts        = ["RX","TX"];
UART1.targetBaudRate           = 115200;
UART1.peripheral.$assign       = "UART0";
UART1.peripheral.rxPin.$assign = "boosterpack.33";
UART1.peripheral.txPin.$assign = "boosterpack.34";
UART1.txPinConfig.$name        = "ti_driverlib_gpio_GPIOPinGeneric0";
UART1.rxPinConfig.$name        = "ti_driverlib_gpio_GPIOPinGeneric1";

/**
 * Pinmux solution for unlocked pins/peripherals. This ensures that minor changes to the automatic solver in a future
 * version of the tool will not impact the pinmux you originally saw.  These lines can be completely deleted in order to
 * re-solve from scratch.
 */
GPIO1.associatedPins[0].pin.$suggestSolution = "j19_expansion.4";
GPIO1.associatedPins[1].pin.$suggestSolution = "j21_expansion.3";
GPIO1.associatedPins[2].pin.$suggestSolution = "boosterpack.23";
GPIO1.associatedPins[3].pin.$suggestSolution = "boosterpack.36";
Board.peripheral.$suggestSolution            = "DEBUGSS";
Board.peripheral.swclkPin.$suggestSolution   = "j25_expansion.16";
Board.peripheral.swdioPin.$suggestSolution   = "j25_expansion.14";
GPIO2.associatedPins[0].pin.$suggestSolution = "j17_expansion.6";
GPIO2.associatedPins[1].pin.$suggestSolution = "boosterpack.19";
GPIO2.associatedPins[2].pin.$suggestSolution = "j19_expansion.1";
GPIO2.associatedPins[3].pin.$suggestSolution = "boosterpack.40";
GPIO2.associatedPins[4].pin.$suggestSolution = "boosterpack.37";
GPIO2.associatedPins[5].pin.$suggestSolution = "boosterpack.38";
GPIO2.associatedPins[6].pin.$suggestSolution = "boosterpack.4";
GPIO2.associatedPins[7].pin.$suggestSolution = "boosterpack.3";
GPIO3.associatedPins[0].pin.$suggestSolution = "j19_expansion.5";
GPIO4.associatedPins[0].pin.$suggestSolution = "j17_expansion.7";
GPIO4.associatedPins[1].pin.$suggestSolution = "boosterpack.32";
GPIO4.associatedPins[2].pin.$suggestSolution = "boosterpack.31";
GPIO4.associatedPins[3].pin.$suggestSolution = "boosterpack.15";
GPIO4.associatedPins[4].pin.$suggestSolution = "boosterpack.7";
GPIO4.associatedPins[5].pin.$suggestSolution = "j19_expansion.6";
GPIO4.associatedPins[6].pin.$suggestSolution = "j19_expansion.8";
GPIO4.associatedPins[7].pin.$suggestSolution = "boosterpack.30";
GPIO5.associatedPins[0].pin.$suggestSolution = "boosterpack.24";
GPIO5.associatedPins[1].pin.$suggestSolution = "boosterpack.27";
GPIO5.associatedPins[3].pin.$suggestSolution = "boosterpack.8";
GPIO5.associatedPins[4].pin.$suggestSolution = "j21_expansion.2";
GPIO6.associatedPins[0].pin.$suggestSolution = "boosterpack.12";
GPIO6.associatedPins[1].pin.$suggestSolution = "boosterpack.39";
GPIO6.associatedPins[2].pin.$suggestSolution = "j19_expansion.2";
GPIO6.associatedPins[3].pin.$suggestSolution = "j19_expansion.3";
GPIO6.associatedPins[4].pin.$suggestSolution = "boosterpack.35";
GPIO6.associatedPins[5].pin.$suggestSolution = "boosterpack.11";
GPIO6.associatedPins[6].pin.$suggestSolution = "boosterpack.6";
GPIO6.associatedPins[7].pin.$suggestSolution = "j19_expansion.10";
SYSCTL.peripheral.$suggestSolution           = "SYSCTL";
